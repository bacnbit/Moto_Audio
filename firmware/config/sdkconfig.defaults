## firmware/config/sdkconfig.defaults
```kconfig
# Moto Audio Unit — ESP-IDF sdkconfig defaults
# These are applied when running `idf.py set-target esp32s3`
# Override in menuconfig as needed

# Target
CONFIG_IDF_TARGET="esp32s3"

# Bluetooth — Classic BT + BLE both needed
CONFIG_BT_ENABLED=y
CONFIG_BT_BLUEDROID_ENABLED=y
CONFIG_BT_CLASSIC_ENABLED=y
CONFIG_BT_A2DP_ENABLE=y
CONFIG_BT_SPP_ENABLED=n
CONFIG_BT_HFP_ENABLE=y
CONFIG_BT_HFP_AG_ENABLE=y
CONFIG_BT_BLE_ENABLED=y
CONFIG_BTDM_CTRL_MODE_BLE_ONLY=n
CONFIG_BTDM_CTRL_MODE_BR_EDR_ONLY=n
CONFIG_BTDM_CTRL_MODE_BTDM=y

# Flash size — ESP32-S3-WROOM-1-N8 has 8MB
CONFIG_ESPTOOLPY_FLASHSIZE_8MB=y
CONFIG_PARTITION_TABLE_CUSTOM=y

# PSRAM — ESP32-S3-WROOM-1 has no PSRAM by default
CONFIG_ESP32S3_SPIRAM_SUPPORT=n

# FreeRTOS tick rate
CONFIG_FREERTOS_HZ=1000

# Log level
CONFIG_LOG_DEFAULT_LEVEL_INFO=y

# UART
CONFIG_ESP_CONSOLE_UART_DEFAULT=y
CONFIG_ESP_CONSOLE_UART_NUM=0

# Watchdog
CONFIG_ESP_TASK_WDT_EN=y
CONFIG_ESP_TASK_WDT_TIMEOUT_S=10

# Audio I2S
CONFIG_I2S_ISR_IRAM_SAFE=y
```
